## arch/x86/cpu/netxfer/Kconfig
```kconfig
# SPDX-License-Identifier: GPL-2.0+
#
# Copyright (C) 2015, Bin Meng <bmeng.cn@gmail.com>

config NETXFER
	bool
	imply USB
	imply USB_OHCI_HCD
```

## board/lg/cosmo/Kconfig
```kconfig
if TARGET_OMAP4_COSMO

config SYS_BOARD
	default "cosmo"

config SYS_VENDOR
	default "lg"

config SYS_CONFIG_NAME
	default "omap4_cosmo"

endif
```

## board/wyse/Kconfig
```kconfig
# SPDX-License-Identifier: GPL-2.0+
#
# Copyright (C) 2015, Bin Meng <bmeng.cn@gmail.com>

if VENDOR_WYSE

choice
	prompt "Mainboard model"

config TARGET_NETXFER
	bool "NETXFER"
	help
	  Seelect this to enable support for devices using Wyse NETXFER recovery environment.

endchoice

source "board/wyse/netxfer/Kconfig"

endif
```

## board/wyse/netxfer/Kconfig
```kconfig
if TARGET_NETXFER

config SYS_BOARD
	default "netxfer"

config SYS_VENDOR
	default "wyse"

config SYS_SOC
	default "netxfer"

config TEXT_BASE
	default 0x0100000

config BOARD_SPECIFIC_OPTIONS # dummy
	def_bool y
	select NETXFER

endif
```

## configs/cosmo_defconfig
```kconfig
CONFIG_ARM=y
CONFIG_ARCH_OMAP2PLUS=y
CONFIG_OMAP44XX=y
CONFIG_TEXT_BASE=0x80000000
CONFIG_SYS_MALLOC_LEN=0x1000000
CONFIG_SYS_MALLOC_F_LEN=0x4000
CONFIG_NR_DRAM_BANKS=2
CONFIG_TARGET_OMAP4_COSMO=y
CONFIG_DEFAULT_DEVICE_TREE="omap4-lge-p920"
CONFIG_SYS_CONSOLE_IS_IN_ENV=n
CONFIG_SYS_LOAD_ADDR=0x90000000
CONFIG_SYS_UBOOT_START=0x80000000
CONFIG_POSITION_INDEPENDENT=y
CONFIG_SYS_CBSIZE=512
CONFIG_SYS_PBSIZE=538
CONFIG_SYS_PROMPT="cosmo # "
CONFIG_CMD_MMC=y
CONFIG_CMD_USB_MASS_STORAGE=y
CONFIG_CMD_VIDCONSOLE=y
CONFIG_ENV_OVERWRITE=y
CONFIG_SYS_I2C_LEGACY=y
CONFIG_MMC_OMAP_HS=y
CONFIG_MMC_OMAP_HS_ADMA=n
CONFIG_HSMMC2_8BIT=y
CONFIG_OF_LIBFDT=y
CONFIG_OF_CONTROL=y
CONFIG_USB=y
CONFIG_DM_USB_GADGET=y
CONFIG_USB_GADGET=y
CONFIG_USB_GADGET_MANUFACTURER="U-Boot"
CONFIG_USB_GADGET_VENDOR_NUM=0x1234
CONFIG_USB_GADGET_PRODUCT_NUM=0x5678
CONFIG_USB_GADGET_DOWNLOAD=y
CONFIG_USB_FUNCTION_MASS_STORAGE=y
CONFIG_USB_MUSB_GADGET=y
CONFIG_USB_MUSB_OMAP2PLUS=y
CONFIG_USB_MUSB_PIO_ONLY=y
CONFIG_DM_SERIAL=y
CONFIG_SERIAL_PRESENT=n
CONFIG_REQUIRE_SERIAL_CONSOLE=n
CONFIG_OMAP_SERIAL=n
CONFIG_SYS_NS16550=n
CONFIG_TWL6030_POWER=y
CONFIG_VIDEO=y
CONFIG_CONSOLE_NORMAL=y
CONFIG_CONSOLE_MUX=n
CONFIG_VIDEO_LOGO=n
CONFIG_VIDEO_SIMPLE=y
CONFIG_SYS_WHITE_ON_BLACK=y
CONFIG_WDT=y
CONFIG_WDT_OMAP3=y
CONFIG_FS_FAT=y
CONFIG_DOS_PARTITION=y
```

## configs/netxfer_defconfig
```kconfig
CONFIG_X86=y
CONFIG_X86_LOAD_FROM_32_BIT=y
CONFIG_BOOTCOMMAND="reset"
CONFIG_USE_PREBOOT=y
CONFIG_PREBOOT="usb start; setenv stdin usbkbd"
CONFIG_BLOBLIST_SIZE_RELOC=0x40000
CONFIG_NR_DRAM_BANKS=2
CONFIG_ENV_SIZE=0x40000
CONFIG_ROM_SIZE=0x100000
CONFIG_MAX_CPUS=1
CONFIG_DEFAULT_DEVICE_TREE="wyse-netxfer"
CONFIG_VENDOR_WYSE=y
CONFIG_TARGET_NETXFER=y
CONFIG_DEBUG_UART=n
CONFIG_SMP=n
CONFIG_APIC=n
CONFIG_I8259_PIC=y
CONFIG_GENERATE_PIRQ_TABLE=y
CONFIG_GENERATE_MP_TABLE=n
CONFIG_SYSRESET_X86=n
CONFIG_FIT=y
CONFIG_BOOTSTD_FULL=y
CONFIG_BOOTSTAGE=y
CONFIG_BOOTSTAGE_REPORT=y
CONFIG_SHOW_BOOT_PROGRESS=y
CONFIG_USE_BOOTARGS=y
CONFIG_BOOTARGS="root=/dev/sdb3 init=/sbin/init rootwait ro"
CONFIG_SYS_CONSOLE_INFO_QUIET=y
CONFIG_LOG=y
CONFIG_LOGF_FUNC=y
CONFIG_DISPLAY_BOARDINFO_LATE=y
CONFIG_PCI_INIT_R=y
CONFIG_BLOBLIST_FIXED=y
CONFIG_BLOBLIST_ADDR=0x10000
CONFIG_CMD_CPU=y
CONFIG_CMD_BOOTEFI_SELFTEST=y
CONFIG_CMD_NVEDIT_EFI=y
CONFIG_CMD_MEM_SEARCH=y
CONFIG_CMD_IDE=n
CONFIG_CMD_SPI=n
CONFIG_CMD_USB=y
CONFIG_CMD_CAT=y
# CONFIG_CMD_SETEXPR is not set
CONFIG_BOOTP_BOOTFILESIZE=y
CONFIG_CMD_EFIDEBUG=y
CONFIG_CMD_TIME=y
CONFIG_CMD_BOOTSTAGE=y
CONFIG_CMD_EXT4_WRITE=y
CONFIG_MAC_PARTITION=y
CONFIG_BOOTFILE="bzImage"
CONFIG_TFTP_TSIZE=y
CONFIG_USE_ROOTPATH=y
CONFIG_SYSCON=y
CONFIG_ACPI=n
CONFIG_USE_CAR=n
CONFIG_ATAPI=n
CONFIG_LBA48=n
CONFIG_SYS_64BIT_LBA=n
CONFIG_CPU=y
CONFIG_NVME_PCI=n
CONFIG_SYS_NS16550_PORT_MAPPED=n
CONFIG_SPI=n
CONFIG_USB_EHCI_HCD=n
CONFIG_USB_EHCI_PCI=n
CONFIG_USB_OHCI_HCD=y
CONFIG_USB_OHCI_PCI=y
CONFIG_USB_KEYBOARD=y
CONFIG_USB_ETHER_ASIX88179=y
CONFIG_CONSOLE_TRUETYPE=n
CONFIG_VIDEO_BOCHS=n
CONFIG_VIDEO_GX1FB=y
CONFIG_REQUIRE_SERIAL_CONSOLE=n
CONFIG_SERIAL_PRESENT=n
# CONFIG_VIDEO_VESA is not set
CONFIG_CONSOLE_SCROLL_LINES=5
CONFIG_GENERATE_ACPI_TABLE=y
CONFIG_CMD_DHRYSTONE=y
# CONFIG_GZIP is not set
```
